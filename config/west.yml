## config/west.yml
```yaml
manifest:
  remotes:
    - name: zmkfirmware
      url-base: https://github.com/zmkfirmware
    - name: caksoylar
      url-base: https://github.com/caksoylar
    - name: geeksville
      url-base: https://github.com/geeksville
    - name: beekeeb
      url-base: https://github.com/beekeeb
    - name: bsg62799
      url-base: https://github.com/Bsg62799
  projects:
    - name: zmk
      remote: zmkfirmware
      import: app/west.yml
      revision: v0.3
    - name: zmk-rgbled-widget
      remote: caksoylar
      revision: v0.3
    - name: zmk_driver_azoteq
      remote: beekeeb
      revision: main
    - name: zmk-input-zoom
      remote: beekeeb
      revision: main
    - name: zmk-anti-idle
      remote: bsg62799
      revision: 0a2b2b81288c6e5c1cded293d0f73e7fb4c20081
  self:
    path: config
```
